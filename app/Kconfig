## app/Kconfig
```kconfig
#
# Copyright (c) 2023 Nordic Semiconductor ASA
#
# SPDX-License-Identifier: LicenseRef-Nordic-5-Clause
#

menu "Remote guard"

config MQTT_SAMPLE_CAMERA_CHUNK_SIZE
	int "Camera chunk size in bytes"
	default 1024
	help
	  Size of each camera image chunk sent over MQTT. Should be 1-4 KB to balance overhead and RAM.

config APP_LOG_LEVEL
	int "log level"
	default 3
	range 0 4
	help
		Log level for the application.

rsource "src/modules/network/Kconfig.network"
rsource "src/modules/mqtt_client/Kconfig.mqtt_client"
rsource "src/modules/transport/Kconfig.transport"
rsource "src/modules/error/Kconfig.error"
rsource "src/modules/camera/Kconfig.camera"
rsource "src/modules/gnss/Kconfig.gnss"
rsource "drivers/esp32cam/Kconfig"

endmenu

menu "Zephyr Kernel"
source "Kconfig.zephyr"
endmenu
```

## app/src/modules/gnss/Kconfig.gnss
```kconfig
#
# Copyright (c) 2023 Nordic Semiconductor ASA
#
# SPDX-License-Identifier: LicenseRef-Nordic-5-Clause
#

menuconfig MQTT_SAMPLE_GNSS
	bool "Enable GNSS module"
	default y
	help
	  Enable the GNSS module for GPS location tracking (nRF modem), or native_sim stubs
	  (tests/mocks/gnss_modem_mock.c) for integration tests.

if MQTT_SAMPLE_GNSS

config MQTT_SAMPLE_GNSS_THREAD_STACK_SIZE
	int "GNSS module thread stack size"
	default 4096
	help
	  Stack size for the GNSS module thread.

config MQTT_SAMPLE_GNSS_MESSAGE_QUEUE_SIZE
	int "GNSS module message queue size"
	default 10
	help
	  Size of the message queue for the GNSS module.

config MQTT_SAMPLE_GNSS_FIX_TIMEOUT
	int "GNSS fix timeout in seconds"
	default 120
	range 10 600
	help
	  Maximum time to wait for a GPS fix before timing out.

module = MQTT_SAMPLE_GNSS
module-str = GNSS
source "subsys/logging/Kconfig.template.log_config"

endif # MQTT_SAMPLE_GNSS
```

## app/src/modules/transport/Kconfig.transport
```kconfig
menu "Transport"
	depends on MQTT_CLIENT
	depends on HW_ID_LIBRARY

config MQTT_SAMPLE_TRANSPORT_RECONNECTION_TIMEOUT_SECONDS
	int "Reconnection timeout in seconds"
	default 60
	help
	  Time in between reconnection attempts to the MQTT broker.

config MQTT_SAMPLE_TRANSPORT_RECONNECT_MAX_ATTEMPTS
	int "Maximum failed MQTT broker connect attempts (0 = no-retry)"
	default 3
	range 0 255
	help
	  Max attempts to connect to MQTT broker server

config MQTT_SAMPLE_TRANSPORT_THREAD_STACK_SIZE
	int "Thread stack size"
	default 2048

config MQTT_SAMPLE_TRANSPORT_MESSAGE_QUEUE_SIZE
	int "Message queue size"
	default 5
	help
	  ZBus subscriber message queue size.

config MQTT_SAMPLE_TRANSPORT_WORKQUEUE_STACK_SIZE
	int "Workqueue stack size"
	default 4096
	help
	  Stack size of the module's internal workqueue.

config MQTT_SAMPLE_TRANSPORT_BROKER_HOSTNAME
	string "MQTT broker hostname"
	default "test.mosquitto.org"

config MQTT_SAMPLE_TRANSPORT_CLIENT_ID
	string "MQTT Client ID"
	default ""
	help
	  Use a custom client ID string. If not set, the client ID will default to the
	  modem's IMEI number for nRF91 Series devices, MAC address for nRF7 Series devices,
	  or use APP_CLIENT_ID_FALLBACK_RANDOM when enabled.

config APP_CLIENT_ID_FALLBACK_RANDOM
	bool "Use random MQTT client id when MQTT client id string is empty"
	default y if BOARD_NATIVE_SIM
	default n
	help
	  If the MQTT client id string is empty, fill the buffer using sys_rand32_get().
	  Enable for host simulation builds that have no hw_id; hardware builds typically
	  use IMEI/MAC via hw_id instead.

config MQTT_SAMPLE_TRANSPORT_CLIENT_ID_BUFFER_SIZE
	int "MQTT Client ID buffer size"
	default 50
	help
	  Size of buffer used to store the MQTT client ID.

config MQTT_SAMPLE_TRANSPORT_SUBSCRIBE_TOPIC
	string "MQTT subscribe topic"
	default "my/subscribe/topic"

config MQTT_GPS_CMD_TOPIC
	string "MQTT gps commands subscribe topic"
	default "device/get_gps"
	depends on MQTT_SAMPLE_GNSS

config MQTT_GPS_DATA_TOPIC
	string "MQTT gps data publish topic"
	default "device/gps"
	depends on MQTT_SAMPLE_GNSS

config MQTT_GPS_ERROR_TOPIC
	string "MQTT GNSS error publish topic (suffix after client id)"
	default "device/gps/error"
	depends on MQTT_SAMPLE_GNSS

config MQTT_CAMERA_PHOTO_META_TOPIC
	string "MQTT camera photo metadata publish topic (suffix after client id)"
	default "camera/photo/meta"
	depends on MQTT_SAMPLE_CAMERA

config MQTT_CAMERA_PHOTO_CHUNK_TOPIC
	string "MQTT camera photo chunk publish topic prefix (suffix after client id; sequence appended)"
	default "camera/photo/chunk"
	depends on MQTT_SAMPLE_CAMERA

config MQTT_CAMERA_ERROR_TOPIC
	string "MQTT camera error publish topic (suffix after client id)"
	default "camera/error"
	depends on MQTT_SAMPLE_CAMERA

module = MQTT_SAMPLE_TRANSPORT
module-str = Transport
source "subsys/logging/Kconfig.template.log_config"

endmenu # Transport
```

## tests/ztest/topic_format/testcase.yaml
```yaml
tests:
  mqtt.topic_format:
    platform_allow:
      - native_sim
    integration_platforms:
      - native_sim
    tags:
      - ztest
      - mqtt
```
